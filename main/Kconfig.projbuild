## main/Kconfig.projbuild
```kconfig
menu "LCD UI Designer"

    config APP_WIFI_SSID
        string "Default WiFi SSID"
        default ""
        help
            Network to join on first boot. Leave empty to start the setup access
            point instead; the network can then be chosen in the web editor.

    config APP_WIFI_PASSWORD
        string "Default WiFi password"
        default ""

    config APP_HOSTNAME
        string "Hostname"
        default "lcd-ui"
        help
            The editor is reachable at http://<hostname>.local via mDNS.

    config APP_AP_PASSWORD
        string "Setup access point password"
        default "lcdsetup"
        help
            WPA2 password of the "LCD-UI-XXXX" setup access point (8+ characters,
            shorter makes the access point open).

    config APP_LCD_PCLK_MHZ
        int "RGB pixel clock (MHz)"
        default 16
        range 8 24
        help
            Lower this if the image flickers or drifts when WiFi is busy.

    config APP_LCD_BOUNCE_LINES
        int "Bounce buffer height in lines (0 = disabled)"
        default 10
        range 0 40
        help
            Bounce buffers in internal RAM keep the panel stable while PSRAM is
            busy. Must divide the panel height (480) evenly.

endmenu
```

## sdkconfig.defaults
```kconfig
# Waveshare ESP32-S3-Touch-LCD-7: ESP32-S3 with 8 MB flash and 8 MB octal PSRAM
CONFIG_IDF_TARGET="esp32s3"
CONFIG_ESPTOOLPY_FLASHMODE_QIO=y
CONFIG_ESPTOOLPY_FLASHSIZE_8MB=y
CONFIG_PARTITION_TABLE_CUSTOM=y
CONFIG_PARTITION_TABLE_CUSTOM_FILENAME="partitions.csv"
CONFIG_BOOTLOADER_APP_ROLLBACK_ENABLE=y
CONFIG_COMPILER_OPTIMIZATION_PERF=y
CONFIG_ESP_DEFAULT_CPU_FREQ_MHZ_240=y
CONFIG_ESP32S3_DATA_CACHE_LINE_64B=y
CONFIG_FREERTOS_HZ=1000
CONFIG_ESP_MAIN_TASK_STACK_SIZE=8192

# PSRAM. Running code/rodata from PSRAM keeps the RGB panel fed while flash is
# being written (layout saves, OTA updates); otherwise the image drifts.
CONFIG_SPIRAM=y
CONFIG_SPIRAM_MODE_OCT=y
CONFIG_SPIRAM_SPEED_80M=y
CONFIG_SPIRAM_XIP_FROM_PSRAM=y
CONFIG_SPIRAM_TRY_ALLOCATE_WIFI_LWIP=y
CONFIG_LCD_RGB_ISR_IRAM_SAFE=y
CONFIG_LCD_RGB_RESTART_IN_VSYNC=y

# Web server / WebSocket
CONFIG_HTTPD_WS_SUPPORT=y
CONFIG_HTTPD_MAX_REQ_HDR_LEN=1024
CONFIG_HTTPD_MAX_URI_LEN=512
CONFIG_LWIP_MAX_SOCKETS=16

# LVGL 9
CONFIG_LV_CONF_SKIP=y
CONFIG_LV_COLOR_DEPTH_16=y
CONFIG_LV_USE_CLIB_MALLOC=y
CONFIG_LV_USE_CLIB_STRING=y
CONFIG_LV_USE_CLIB_SPRINTF=y
CONFIG_LV_DEF_REFR_PERIOD=15
CONFIG_LV_USE_SNAPSHOT=y
CONFIG_LV_BUILD_EXAMPLES=n
CONFIG_LV_BUILD_DEMOS=n
CONFIG_LV_FONT_MONTSERRAT_12=y
CONFIG_LV_FONT_MONTSERRAT_14=y
CONFIG_LV_FONT_MONTSERRAT_16=y
CONFIG_LV_FONT_MONTSERRAT_18=y
CONFIG_LV_FONT_MONTSERRAT_20=y
CONFIG_LV_FONT_MONTSERRAT_22=y
CONFIG_LV_FONT_MONTSERRAT_24=y
CONFIG_LV_FONT_MONTSERRAT_28=y
CONFIG_LV_FONT_MONTSERRAT_32=y
CONFIG_LV_FONT_MONTSERRAT_36=y
CONFIG_LV_FONT_MONTSERRAT_40=y
CONFIG_LV_FONT_MONTSERRAT_48=y
CONFIG_LV_FONT_DEFAULT_MONTSERRAT_16=y
```
